## arch/arm64/configs/marshall_defconfig
```kconfig
# Adreno Idler
CONFIG_ADRENO_IDLER=y

# Boeffla WakeLock Blocker
CONFIG_BOEFFLA_WL_BLOCKER=y

# CPU Input boost
CONFIG_CPU_INPUT_BOOST=y
CONFIG_INPUT_BOOST_DURATION_MS=100
CONFIG_WAKE_BOOST_DURATION_MS=1500
CONFIG_INPUT_BOOST_FREQ_LP=844800
CONFIG_INPUT_BOOST_FREQ_PERF=748800
CONFIG_REMOVE_INPUT_BOOST_FREQ_LP=307200
CONFIG_REMOVE_INPUT_BOOST_FREQ_PERF=307200

# DriveDroid
CONFIG_DRIVEDROID_CDROM=y

# exFAT
CONFIG_EXFAT_FS=y
CONFIG_EXFAT_DISCARD=y
# CONFIG_EXFAT_DELAYED_SYNC is not set
# CONFIG_EXFAT_KERNEL_DEBUG is not set
# CONFIG_EXFAT_DEBUG_MSG is not set
CONFIG_EXFAT_DEFAULT_CODEPAGE=437
CONFIG_EXFAT_DEFAULT_IOCHARSET="utf8"

# Fast Charge
CONFIG_FORCE_FAST_CHARGE=y

# Kcal
CONFIG_FB_MSM_MDSS_KCAL_CTRL=y

# Power tweaks
CONFIG_SCHED_HMP_CSTATE_AWARE=y
CONFIG_WQ_POWER_EFFICIENT_DEFAULT=y
CONFIG_TCP_CONG_WESTWOOD=y
CONFIG_IOSCHED_MAPLE=y
CONFIG_DEFAULT_TCP_CONG="westwood"
CONFIG_DEFAULT_WESTWOOD=y

# WireGuard
CONFIG_WIREGUARD=y
```
